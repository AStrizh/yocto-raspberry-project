## yocto/poky/build/conf/bblayers.conf
```bitbake
# POKY_BBLAYERS_CONF_VERSION is increased each time build/conf/bblayers.conf
# changes incompatibly
POKY_BBLAYERS_CONF_VERSION = "2"

BBPATH = "${TOPDIR}"

# Layers to include in the build
BBLAYERS ?= " \
  /home/astrizh/Documents/yocto/poky/meta \
  /home/astrizh/Documents/yocto/poky/meta-poky \
  /home/astrizh/Documents/yocto/poky/meta-yocto-bsp \
  /home/astrizh/Documents/yocto/meta-raspberrypi \
  /home/astrizh/Documents/yocto/meta-openembedded/meta-oe \
  /home/astrizh/Documents/yocto/meta-openembedded/meta-python \
  /home/astrizh/Documents/yocto/meta-openembedded/meta-networking \
  "
```
